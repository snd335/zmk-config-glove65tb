#include "glove65tb.dtsi"

&kscan0 {
        col-gpios
            = <&xiao_d 10 GPIO_ACTIVE_HIGH>
            , <&gpio1 7  GPIO_ACTIVE_HIGH>
            , <&xiao_d 9  GPIO_ACTIVE_HIGH>
            , <&gpio1 5  GPIO_ACTIVE_HIGH>
            , <&xiao_d 8  GPIO_ACTIVE_HIGH>
            , <&gpio1 3  GPIO_ACTIVE_HIGH>
            , <&xiao_d 7  GPIO_ACTIVE_HIGH>
            ;
};

&left_encoder {
    status = "okay";
};
