## boards/shields/glove65tb/Kconfig.shield
```kconfig
config SHIELD_GLOVE65TB_R
    def_bool $(shields_list_contains,glove65tb_R)

config SHIELD_GLOVE65TB_L
    def_bool $(shields_list_contains,glove65tb_L)
```

## config/west.yml
```yaml
manifest:
  remotes:
    - name: zmkfirmware
      url-base: https://github.com/zmkfirmware
    - name: keebkuro
      url-base: https://github.com/keebkuro
  projects:
    - name: zmk
      remote: zmkfirmware
      revision: main
      import: app/west.yml
    - name: zmk-pmw3610-driver
      remote: keebkuro
      revision: main
  self:
    path: config
```
